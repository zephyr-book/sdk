## CMakeLists.txt
```
# SPDX-License-Identifier: Apache-2.0
#
# Copyright (c) Centro de Inovacao EDGE - 2026

cmake_minimum_required(VERSION 3.20.0)
include(${CMAKE_CURRENT_SOURCE_DIR}/../../unit.cmake)
zbook_unit_test(microphone)
```

## prj.conf
```kconfig
CONFIG_ZTEST=y
CONFIG_ZBOOK_INTERFACE_SENSORS=y
CONFIG_ZBOOK_INTERFACE_SENSORS_MICROPHONE=y

CONFIG_ADC=y
```

## app.overlay
```dts
#include <zephyr/dt-bindings/adc/adc.h>

adc: &adc0 {
	ref-internal-mv = <3300>;
	#address-cells = <1>;
	#size-cells = <0>;

	zephyr,deferred-init;

	microphone_adc: channel@0 {
		reg = <0>;
		zephyr,gain = "ADC_GAIN_1";
		zephyr,reference = "ADC_REF_INTERNAL";
		zephyr,acquisition-time = <ADC_ACQ_TIME_DEFAULT>;
	};
};
```

## read_failure.overlay
```dts
/*
 * Layered on top of app.overlay for the interface.sensors.microphone.read_failure
 * scenario. Repoints microphone_adc at channel 5, past adc0's 2-channel range, so
 * adc_read() itself rejects the sequence (adc_emul_start_read's channel
 * mask check), regardless of whether adc_channel_setup() ever succeeded.
 */

&microphone_adc {
	reg = <5>;
};
```

## setup_failure.overlay
```dts
/*
 * Layered on top of app.overlay for the interface.sensors.microphone.setup_failure
 * scenario. Repoints microphone_adc at ADC_REF_EXTERNAL0, whose reference voltage
 * adc_emul defaults to 0mV (app.overlay only sets ref-internal-mv), so
 * adc_channel_setup() genuinely fails with -ENOTSUP.
 */

&microphone_adc {
	zephyr,reference = "ADC_REF_EXTERNAL0";
};
```

## src/main.c
```c
/*******************************************************************
 * @file main.c
 *
 * @brief Unit tests for the Zbook microphone sensor input.
 *
 * @author Matheus Macário dos Santos (matheus.macario@edge.ufal.br)
 * @version 0.1
 * @date 23/09/2026
 *
 * @copyright Copyright (c) Centro de Inovacao EDGE - 2026
 *
 *******************************************************************/

#include <zephyr/device.h>
#include <zephyr/drivers/adc.h>
#include <zephyr/drivers/adc/adc_emul.h>
#include <zephyr/ztest.h>

#include "sensors/zbook_microphone.h"

#define MICROPHONE_ADC_CTLR DT_NODELABEL(adc)
#define MICROPHONE_CHANNEL  0

static const struct device *adc_dev;

#if defined(MICROPHONE_TEST_SETUP_FAILURE)

static void *microphone_suite_setup(void)
{
	adc_dev = DEVICE_DT_GET(MICROPHONE_ADC_CTLR);

	zassert_ok(device_init(adc_dev), "failed to initialize ADC emulator device");
	zassert_true(device_is_ready(adc_dev), "ADC emulator device not ready");

	return NULL;
}

ZTEST_SUITE(zbook_microphone, NULL, microphone_suite_setup, NULL, NULL, NULL);

ZTEST(zbook_microphone, test_init_reports_channel_setup_failure)
{
	zassert_equal(zbook_microphone_init(), -ENOTSUP,
		      "expected adc_channel_setup()'s failure to propagate");
}

#elif defined(MICROPHONE_TEST_READ_FAILURE)

static void *microphone_suite_setup(void)
{
	adc_dev = DEVICE_DT_GET(MICROPHONE_ADC_CTLR);

	zassert_ok(device_init(adc_dev), "failed to initialize ADC emulator device");
	zassert_true(device_is_ready(adc_dev), "ADC emulator device not ready");

	return NULL;
}

ZTEST_SUITE(zbook_microphone, NULL, microphone_suite_setup, NULL, NULL, NULL);

ZTEST(zbook_microphone, test_read_reports_adc_read_failure)
{
	uint16_t value = 123;

	zassert_not_equal(zbook_microphone_read(&value), 0,
			   "expected adc_read()'s failure to propagate");
}

#else

ZTEST_SUITE(zbook_hw_errors, NULL, NULL, NULL, NULL, NULL);

ZTEST(zbook_hw_errors, test_init_fails_while_device_not_ready)
{
	const struct device *dev = DEVICE_DT_GET(MICROPHONE_ADC_CTLR);

	zassert_false(device_is_ready(dev), "test setup: ADC device already ready");

	zassert_equal(zbook_microphone_init(), -ENODEV);

	zassert_ok(device_init(dev), "failed to initialize ADC emulator device for later tests");
	zassert_true(device_is_ready(dev));
}

static void *microphone_suite_setup(void)
{
	adc_dev = DEVICE_DT_GET(MICROPHONE_ADC_CTLR);
	zassert_true(device_is_ready(adc_dev), "ADC emulator device not ready");

	zassert_ok(zbook_microphone_init(), "zbook_microphone_init() failed");

	return NULL;
}

ZTEST_SUITE(zbook_microphone, NULL, microphone_suite_setup, NULL, NULL, NULL);

ZTEST(zbook_microphone, test_read_rejects_null_pointer)
{
	zassert_equal(zbook_microphone_read(NULL), -EINVAL);
}

static const uint32_t microphone_raw_cases[] = {0, 1, 2048, 4094, 4095};

ZTEST(zbook_microphone, test_read_returns_raw_sample)
{
	for (size_t i = 0; i < ARRAY_SIZE(microphone_raw_cases); i++) {
		uint16_t value = 0xffff;

		zassert_ok(adc_emul_const_raw_value_set(adc_dev, MICROPHONE_CHANNEL,
							 microphone_raw_cases[i]));
		zassert_ok(zbook_microphone_read(&value));
		zassert_equal(value, microphone_raw_cases[i], "raw=%u: got %u",
			      microphone_raw_cases[i], value);
	}
}

#endif /* MICROPHONE_TEST_SETUP_FAILURE / MICROPHONE_TEST_READ_FAILURE */
```
