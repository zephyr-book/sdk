## CMakeLists.txt
```
# SPDX-License-Identifier: Apache-2.0
#
# Copyright (c) Centro de Inovacao EDGE - 2026

cmake_minimum_required(VERSION 3.20.0)

include(${CMAKE_CURRENT_SOURCE_DIR}/../../unit.cmake)
zbook_unit_test(led_rgb)

target_sources(app PRIVATE ${CMAKE_CURRENT_SOURCE_DIR}/src/zbook_led_rgb_fake_strip.c)
```

## prj.conf
```kconfig
CONFIG_ZTEST=y

CONFIG_ZBOOK_INTERFACE_ACTUATORS=y
CONFIG_ZBOOK_INTERFACE_ACTUATORS_LED_RGB=y
CONFIG_ZBOOK_LED_RGB_LOG_LEVEL_ERR=y
```

## app.overlay
```dts
/*
 * Fake LED strip node so zbook_led_rgb's "led-strip" alias resolves on
 * native_sim, bound to a hand-written fake driver (src/
 * zbook_led_rgb_fake_strip.c) instead of a real WS2812 backend -- no
 * WS2812/PIO peripheral exists to emulate on native_sim, so the fake driver
 * just captures whatever led_strip_update_rgb() sends it for a test to
 * inspect afterward.
 */

#include <zephyr/dt-bindings/led/led.h>

/ {
	/*
	 * zephyr,deferred-init keeps this "not ready" until a test explicitly
	 * calls device_init() on it, so zbook_led_rgb_init()'s -ENODEV path
	 * is reachable.
	 */
	zbook_led_rgb_fake: led_strip_fake {
		compatible = "zbook,led-strip-fake";
		chain-length = <4>;
		color-mapping = <LED_COLOR_ID_GREEN LED_COLOR_ID_RED LED_COLOR_ID_BLUE>;
		status = "okay";
		zephyr,deferred-init;
	};

	aliases {
		led-strip = &zbook_led_rgb_fake;
	};
};
```

## dts/bindings/zbook,led-strip-fake.yaml
```yaml
description: ZBook fake LED strip driver (unit test only)

compatible: "zbook,led-strip-fake"

include: [base.yaml, led-strip.yaml]
```

## src/main.c
```c
/*******************************************************************
 * @file main.c
 *
 * @brief Unit tests for the Zbook addressable RGB LED actuator interface.
 * @author Matheus Macário dos Santos (matheus.macario@edge.ufal.br)
 * @version 0.1
 * @date 21/09/2026
 *
 * @copyright Copyright (c) Centro de Inovacao EDGE - 2026
 *
 *******************************************************************/

#include <errno.h>
#include <zephyr/ztest.h>
#include <zephyr/device.h>
#include <zephyr/drivers/led_strip.h>

#include "actuators/zbook_led_rgb.h"
#include "zbook_led_rgb_fake_strip.h"

#define NUM_PIXELS ZBOOK_LED_RGB_ALL

#define BLACK ((struct zbook_led_rgb_color){0})
#define RED   ((struct zbook_led_rgb_color){.r = 0xFF})
#define GREEN ((struct zbook_led_rgb_color){.g = 0xFF})
#define BLUE  ((struct zbook_led_rgb_color){.b = 0xFF})

/* Every zbook_led_rgb_set()/off() call sends the whole strip in one frame,
 * so the fake's last capture always reflects the current state of every
 * pixel, not just the one a given call touched.
 */
static struct zbook_led_rgb_color pixel_color(enum zbook_led_rgb led)
{
	struct led_rgb pixels[NUM_PIXELS] = {0};

	zbook_led_rgb_test_fake_last_update(pixels, NUM_PIXELS);

	return (struct zbook_led_rgb_color){
		.r = pixels[led].r,
		.g = pixels[led].g,
		.b = pixels[led].b,
	};
}

static bool color_equal(struct zbook_led_rgb_color a, struct zbook_led_rgb_color b)
{
	return a.r == b.r && a.g == b.g && a.b == b.b;
}

/* Pure conversion, no hardware involved -- doesn't need the strip fixture. */
ZTEST_SUITE(zbook_led_rgb_color, NULL, NULL, NULL, NULL, NULL);

ZTEST(zbook_led_rgb_color, test_from_rgb24_splits_channels)
{
	/* "Tomato" (0xFF6347) written in hex vs. the exact same value written
	 * in decimal -- the function has no notion of "hex" vs "decimal", it
	 * just receives a uint32_t, so both calls must produce the same color.
	 */
	struct zbook_led_rgb_color hex = zbook_led_rgb_color_from_rgb24(0xFF6347);
	struct zbook_led_rgb_color decimal = zbook_led_rgb_color_from_rgb24(16737095);

	zassert_true(color_equal(hex, decimal));
	zassert_equal(0xFF, hex.r);
	zassert_equal(0x63, hex.g);
	zassert_equal(0x47, hex.b);
}

ZTEST(zbook_led_rgb_color, test_from_rgb24_black_and_white)
{
	zassert_true(color_equal(BLACK, zbook_led_rgb_color_from_rgb24(0x000000)));
	zassert_true(color_equal((struct zbook_led_rgb_color){0xFF, 0xFF, 0xFF},
				  zbook_led_rgb_color_from_rgb24(0xFFFFFF)));
}

ZTEST(zbook_led_rgb_color, test_from_rgb24_ignores_bits_above_24)
{
	struct zbook_led_rgb_color a = zbook_led_rgb_color_from_rgb24(0x00FF0000);
	struct zbook_led_rgb_color b = zbook_led_rgb_color_from_rgb24(0xAAFF0000);

	zassert_true(color_equal(a, b));
	zassert_true(color_equal(RED, a));
}

/*
 * The fake led-strip's devicetree node is marked "zephyr,deferred-init", so
 * it boots "not ready" -- this suite exercises zbook_led_rgb_init()'s
 * -ENODEV path while that holds, then brings the device up (device_init())
 * for the rest of the run. Must run before the "zbook_led_rgb" suite below,
 * which assumes a ready device in its fixture.
 */
ZTEST_SUITE(zbook_hw_errors, NULL, NULL, NULL, NULL, NULL);

ZTEST(zbook_hw_errors, test_init_fails_while_device_not_ready)
{
	const struct device *strip = DEVICE_DT_GET(DT_NODELABEL(zbook_led_rgb_fake));

	zassert_false(device_is_ready(strip), "test setup: strip already ready");

	zassert_equal(-ENODEV, zbook_led_rgb_init());

	zassert_ok(device_init(strip), "failed to bring up fake strip for later tests");
	zassert_true(device_is_ready(strip));
}

static void zbook_led_rgb_before(void *fixture)
{
	ARG_UNUSED(fixture);

	zbook_led_rgb_test_fake_reset();
	zassert_ok(zbook_led_rgb_init(), "zbook_led_rgb_init failed");
}

ZTEST_SUITE(zbook_led_rgb, NULL, NULL, zbook_led_rgb_before, NULL, NULL);

ZTEST(zbook_led_rgb, test_init_returns_ok_when_device_ready)
{
	zassert_ok(zbook_led_rgb_init());
}

ZTEST(zbook_led_rgb, test_init_clears_every_pixel)
{
	for (enum zbook_led_rgb led = ZBOOK_LED_RGB_0; led < ZBOOK_LED_RGB_ALL; led++) {
		zassert_true(color_equal(BLACK, pixel_color(led)), "led %d not cleared", led);
	}
}

ZTEST(zbook_led_rgb, test_set_updates_pixel_color)
{
	zassert_ok(zbook_led_rgb_set(ZBOOK_LED_RGB_1, RED));
	zassert_true(color_equal(RED, pixel_color(ZBOOK_LED_RGB_1)));
}

ZTEST(zbook_led_rgb, test_set_does_not_affect_other_pixels)
{
	zassert_ok(zbook_led_rgb_set(ZBOOK_LED_RGB_0, GREEN));

	zassert_true(color_equal(GREEN, pixel_color(ZBOOK_LED_RGB_0)));
	zassert_true(color_equal(BLACK, pixel_color(ZBOOK_LED_RGB_1)));
	zassert_true(color_equal(BLACK, pixel_color(ZBOOK_LED_RGB_2)));
	zassert_true(color_equal(BLACK, pixel_color(ZBOOK_LED_RGB_3)));
}

ZTEST(zbook_led_rgb, test_off_sets_pixel_black)
{
	zassert_ok(zbook_led_rgb_set(ZBOOK_LED_RGB_1, BLUE));
	zassert_ok(zbook_led_rgb_off(ZBOOK_LED_RGB_1));
	zassert_true(color_equal(BLACK, pixel_color(ZBOOK_LED_RGB_1)));
}

ZTEST(zbook_led_rgb, test_all_sets_every_pixel)
{
	zassert_ok(zbook_led_rgb_set(ZBOOK_LED_RGB_ALL, RED));

	for (enum zbook_led_rgb led = ZBOOK_LED_RGB_0; led < ZBOOK_LED_RGB_ALL; led++) {
		zassert_true(color_equal(RED, pixel_color(led)), "led %d not set", led);
	}
}

ZTEST(zbook_led_rgb, test_off_all_turns_off_every_pixel)
{
	zassert_ok(zbook_led_rgb_set(ZBOOK_LED_RGB_ALL, RED));
	zassert_ok(zbook_led_rgb_off(ZBOOK_LED_RGB_ALL));

	for (enum zbook_led_rgb led = ZBOOK_LED_RGB_0; led < ZBOOK_LED_RGB_ALL; led++) {
		zassert_true(color_equal(BLACK, pixel_color(led)), "led %d not off", led);
	}
}

ZTEST(zbook_led_rgb, test_set_rejects_invalid_led)
{
	zassert_equal(-EINVAL, zbook_led_rgb_set((enum zbook_led_rgb)-1, RED));
	zassert_equal(-EINVAL, zbook_led_rgb_set((enum zbook_led_rgb)(ZBOOK_LED_RGB_ALL + 1), RED));
}

ZTEST(zbook_led_rgb, test_off_rejects_invalid_led)
{
	zassert_equal(-EINVAL, zbook_led_rgb_off((enum zbook_led_rgb)-1));
	zassert_equal(-EINVAL, zbook_led_rgb_off((enum zbook_led_rgb)(ZBOOK_LED_RGB_ALL + 1)));
}

ZTEST(zbook_led_rgb, test_set_mask_affects_only_selected_pixels)
{
	zassert_ok(zbook_led_rgb_set_mask(BIT(ZBOOK_LED_RGB_0) | BIT(ZBOOK_LED_RGB_2), GREEN));

	zassert_true(color_equal(GREEN, pixel_color(ZBOOK_LED_RGB_0)));
	zassert_true(color_equal(BLACK, pixel_color(ZBOOK_LED_RGB_1)));
	zassert_true(color_equal(GREEN, pixel_color(ZBOOK_LED_RGB_2)));
	zassert_true(color_equal(BLACK, pixel_color(ZBOOK_LED_RGB_3)));
}

ZTEST(zbook_led_rgb, test_off_mask_affects_only_selected_pixels)
{
	zassert_ok(zbook_led_rgb_set_mask(BIT(ZBOOK_LED_RGB_ALL) - 1, RED));
	zassert_ok(zbook_led_rgb_off_mask(BIT(ZBOOK_LED_RGB_1) | BIT(ZBOOK_LED_RGB_3)));

	zassert_true(color_equal(RED, pixel_color(ZBOOK_LED_RGB_0)));
	zassert_true(color_equal(BLACK, pixel_color(ZBOOK_LED_RGB_1)));
	zassert_true(color_equal(RED, pixel_color(ZBOOK_LED_RGB_2)));
	zassert_true(color_equal(BLACK, pixel_color(ZBOOK_LED_RGB_3)));
}

ZTEST(zbook_led_rgb, test_set_mask_rejects_invalid_bit)
{
	zassert_equal(-EINVAL, zbook_led_rgb_set_mask(BIT(ZBOOK_LED_RGB_ALL), RED));
	zassert_equal(-EINVAL, zbook_led_rgb_set_mask(0, RED));
}

ZTEST(zbook_led_rgb, test_off_mask_rejects_invalid_bit)
{
	zassert_equal(-EINVAL, zbook_led_rgb_off_mask(BIT(ZBOOK_LED_RGB_ALL)));
	zassert_equal(-EINVAL, zbook_led_rgb_off_mask(0));
}
```

## src/zbook_led_rgb_fake_strip.c
```c
/*******************************************************************
 * @file zbook_led_rgb_fake_strip.c
 *
 * @brief Fake led_strip driver backing the "led-strip" devicetree alias for unit tests.
 * @author Matheus Macário dos Santos (matheus.macario@edge.ufal.br)
 * @version 0.1
 * @date 21/09/2026
 *
 * @copyright Copyright (c) Centro de Inovacao EDGE - 2026
 *
 *******************************************************************/

#include "zbook_led_rgb_fake_strip.h"

#include <string.h>
#include <zephyr/device.h>
#include <zephyr/drivers/led_strip.h>
#include <zephyr/sys/util.h>

#define STRIP_NODE         DT_NODELABEL(zbook_led_rgb_fake)
#define MAX_CAPTURE_PIXELS 8

static struct led_rgb captured[MAX_CAPTURE_PIXELS];
static size_t captured_count;

void zbook_led_rgb_test_fake_reset(void)
{
	memset(captured, 0, sizeof(captured));
	captured_count = 0;
}

size_t zbook_led_rgb_test_fake_last_update(struct led_rgb *out, size_t max_len)
{
	size_t len = MIN(captured_count, max_len);

	memcpy(out, captured, len * sizeof(struct led_rgb));

	return len;
}

static int fake_strip_update_rgb(const struct device *dev, struct led_rgb *pixels,
				  size_t num_pixels)
{
	ARG_UNUSED(dev);

	captured_count = MIN(num_pixels, MAX_CAPTURE_PIXELS);
	memcpy(captured, pixels, captured_count * sizeof(struct led_rgb));

	return 0;
}

static int fake_strip_init(const struct device *dev)
{
	ARG_UNUSED(dev);

	return 0;
}

static const struct led_strip_driver_api fake_strip_api = {
	.update_rgb = fake_strip_update_rgb,
};

DEVICE_DT_DEFINE(STRIP_NODE, fake_strip_init, NULL, NULL, NULL, POST_KERNEL,
		 CONFIG_KERNEL_INIT_PRIORITY_DEVICE, &fake_strip_api);
```

## src/zbook_led_rgb_fake_strip.h
```c
/*******************************************************************
 * @file zbook_led_rgb_fake_strip.h
 *
 * @brief Fake led_strip test helpers for zbook_led_rgb's unit tests.
 * @author Matheus Macário dos Santos (matheus.macario@edge.ufal.br)
 * @version 0.1
 * @date 21/09/2026
 *
 * @copyright Copyright (c) Centro de Inovacao EDGE - 2026
 *
 *******************************************************************/

#ifndef ZBOOK_LED_RGB_FAKE_STRIP_H
#define ZBOOK_LED_RGB_FAKE_STRIP_H

#include <stddef.h>
#include <zephyr/drivers/led_strip.h>

/** @brief Reset captured state to zero. */
void zbook_led_rgb_test_fake_reset(void);

/**
 * @brief Copy the pixel buffer captured from the last led_strip_update_rgb()
 * call made against the fake strip.
 *
 * @param out     Destination buffer.
 * @param max_len Capacity of @p out, in pixels.
 * @return Number of pixels copied.
 */
size_t zbook_led_rgb_test_fake_last_update(struct led_rgb *out, size_t max_len);

#endif /* ZBOOK_LED_RGB_FAKE_STRIP_H */
```
