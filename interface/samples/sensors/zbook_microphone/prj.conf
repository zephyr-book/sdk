## CMakeLists.txt
```
# SPDX-License-Identifier: Apache-2.0
#
# Copyright (c) Centro de Inovacao EDGE - 2026

cmake_minimum_required(VERSION 3.20.0)

if(NOT DEFINED BOARD)
    set(BOARD zbook/rp2350b/m33)
endif()

find_package(Zephyr REQUIRED HINTS $ENV{ZEPHYR_BASE})
project(zbook_microphone_sample)

target_sources(app PRIVATE src/main.c)
```

## Kconfig
```
# SPDX-License-Identifier: Apache-2.0
#
# Copyright (c) Centro de Inovacao EDGE - 2026

mainmenu "ZBook microphone sample"

config APP_SAMPLE_WINDOW_MS
	int "Sampling window (ms)"
	default 200
	range 1 10000
	help
	  Duration of each burst of ADC reads used to compute the
	  min/max/peak-to-peak values.

config APP_REPORT_INTERVAL_MS
	int "Interval between reports (ms)"
	default 1000
	range 0 60000
	help
	  Time to sleep after each sampling window before starting the next one.

source "Kconfig.zephyr"
```

## sample.yaml
```
sample:
  name: ZBook microphone sensor
  description: >
    Reads the ZBook microphone through the zbook_microphone interface and
    logs the min/max/peak-to-peak ADC values of each sampling window.
tests:
  sample.sensors.zbook_microphone:
    tags:
      - samples
      - interface
      - sensors
      - microphone
    platform_allow:
      - zbook@p2/rp2350b/m33
    build_only: true
```

## prj.conf
```kconfig
CONFIG_ZBOOK_INTERFACE_SENSORS=y
CONFIG_ZBOOK_INTERFACE_SENSORS_MICROPHONE=y
CONFIG_LOG=y
```

## src/main.c
```c
/*******************************************************************
 * @file main.c
 *
 * @brief Sample application for the Zbook microphone sensor input.
 * @author Matheus Macário dos Santos (matheus.macario@edge.ufal.br) 
 * @version 0.1
 * @date 23/09/2026
 *
 * @copyright Copyright (c) Centro de Inovacao EDGE - 2026
 *
 *******************************************************************/

#include <zephyr/kernel.h>
#include <zephyr/logging/log.h>

#include "sensors/zbook_microphone.h"

LOG_MODULE_REGISTER(zbook_microphone_sample);

int main(void)
{
	int ret;
	uint16_t sample;
	uint16_t min;
	uint16_t max;
	uint32_t valid_samples;
	int64_t window_end;

	ret = zbook_microphone_init();
	if (ret) {
		LOG_ERR("zbook_microphone_init failed (%d)", ret);
		return ret;
	}

	while (1) {
		min = UINT16_MAX;
		max = 0;
		valid_samples = 0;
		window_end = k_uptime_get() + CONFIG_APP_SAMPLE_WINDOW_MS;

		while (k_uptime_get() < window_end) {
			ret = zbook_microphone_read(&sample);
			if (ret) {
				LOG_ERR("zbook_microphone_read failed (%d)", ret);
				continue;
			}

			valid_samples++;

			if (sample < min) {
				min = sample;
			}
			if (sample > max) {
				max = sample;
			}
		}

		if (valid_samples == 0) {
			LOG_WRN("mic: no valid samples in window");
		} else {
			LOG_INF("mic: min=%u max=%u peak-to-peak=%u", min, max, max - min);
		}

		k_sleep(K_MSEC(CONFIG_APP_REPORT_INTERVAL_MS));
	}

	return 0;
}
```
