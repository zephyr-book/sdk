## CMakeLists.txt
```
# SPDX-License-Identifier: Apache-2.0
#
# Copyright (c) Centro de Inovacao EDGE - 2026

cmake_minimum_required(VERSION 3.20.0)

if(NOT DEFINED BOARD)
    set(BOARD zbook/rp2350b/m33)
endif()

find_package(Zephyr REQUIRED HINTS $ENV{ZEPHYR_BASE})

project(zbook_i2c_probe)

target_sources(app PRIVATE src/main.c)
```

## sample.yaml
```
sample:
  name: ZBook I2C bus probe (master)
  description: >
    Bring-up sample that scans the external GPIO header's I2C bus (H1,
    I2C_SDA/I2C_SCL) every 2 seconds and reports every address that ACKs.
    Needs a real I2C target wired to H1 to prove anything -- see
    samples/protocols/zbook_i2c_probe/nrf52_target/ -- not something
    twister can assert on its own, hence build_only below.
tests:
  sample.protocols.zbook_i2c_probe.master:
    tags:
      - samples
      - interface
      - protocols
      - i2c
    platform_allow:
      - zbook/rp2350b/m33
    build_only: true
```

## prj.conf
```kconfig
CONFIG_ZBOOK_INTERFACE_PROTOCOLS=y
CONFIG_ZBOOK_INTERFACE_PROTOCOLS_I2C=y
CONFIG_LOG=y
CONFIG_ZBOOK_I2C_LOG_LEVEL_DBG=y
```

## src/main.c
```c
/*******************************************************************
 * @file main.c
 *
 * @brief Sample application for the zbook I2C bus interface.
 * @author Matheus Macário dos Santos (matheus.macario@edge.ufal.br)
 * @version 0.1
 * @date 18/09/2026
 *
 * @copyright Copyright (c) Centro de Inovacao EDGE - 2026
 *
 *******************************************************************/

#include <zephyr/kernel.h>
#include <zephyr/sys/printk.h>

#include "protocols/zbook_i2c.h"

#define SCAN_ADDR_MIN 0x08
#define SCAN_ADDR_MAX 0x77
#define SCAN_PERIOD   K_SECONDS(2)

int main(void)
{
	int ret;

	printk("zbook i2c bus scanner -- probing 0x%02x..0x%02x on the external header (H1)\n",
	       SCAN_ADDR_MIN, SCAN_ADDR_MAX);

	ret = zbook_i2c_init();
	if (ret < 0) {
		printk("zbook_i2c_init failed: %d -- is i2c0 ready?\n", ret);
		return 0;
	}

	const struct zbook_i2c_cfg cfg = {.speed = ZBOOK_I2C_SPEED_STANDARD_100K};

	ret = zbook_i2c_configure(&cfg);
	if (ret < 0) {
		printk("zbook_i2c_configure failed: %d\n", ret);
		return 0;
	}

	while (1) {
		int found = 0;

		for (uint16_t addr = SCAN_ADDR_MIN; addr <= SCAN_ADDR_MAX; addr++) {
			uint8_t dummy;

			if (zbook_i2c_read(addr, &dummy, sizeof(dummy)) == 0) {
				printk("  ACK at 0x%02x\n", addr);
				found++;
			}
		}

		if (found == 0) {
			printk("scan complete -- no device acked (0x%02x-0x%02x)\n",
			       SCAN_ADDR_MIN, SCAN_ADDR_MAX);
		} else {
			printk("scan complete -- %d device(s) found\n", found);
		}

		k_sleep(SCAN_PERIOD);
	}

	return 0;
}
```
