## interface/Kconfig.actuators
```kconfig
menu "ZBook Interface - Actuators"

config ZBOOK_INTERFACE_ACTUATORS
    bool "Enable ZBook Interface Actuators"
    default n
    help
      Enable the ZBook Interface Actuators module.

    menu "ZBook LED Actuator"
        depends on ZBOOK_INTERFACE_ACTUATORS

        config ZBOOK_INTERFACE_ACTUATORS_LED
            bool "Enable ZBook LED actuator"
            default y
            help
                Enable the ZBook LED actuator interface.


        config ZBOOK_INTERFACE_ACTUATORS_LED_BLINK_DEFAULT_MS
            int "Default LED blink duration (ms)"
            default 500
            depends on ZBOOK_INTERFACE_ACTUATORS_LED
            help
                Set the default blink duration for the ZBook LED actuator in milliseconds.
        
        config ZBOOK_INTERFACE_ACTUATORS_LED_BLINK_SLOW_MS
            int "Slow LED blink duration (ms)"
            default 1000
            depends on ZBOOK_INTERFACE_ACTUATORS_LED
            help
                Set the slow blink duration for the ZBook LED actuator in milliseconds.

        config ZBOOK_INTERFACE_ACTUATORS_LED_BLINK_FAST_MS
            int "Fast LED blink duration (ms)"
            default 250
            depends on ZBOOK_INTERFACE_ACTUATORS_LED
            help
                Set the fast blink duration for the ZBook LED actuator in milliseconds.
    endmenu

    menu "Zbook Buzzer Actuator"
        depends on ZBOOK_INTERFACE_ACTUATORS
    
        config ZBOOK_INTERFACE_ACTUATOR_BUZZER
            bool "Enables ZBook buzzer actuator"
            select PWM
            default y

        config ZBOOK_INTERFACE_ACTUATOR_BUZZER_BEEP_DURATION_SHORT_MS
            int "Short beep duration (ms)"
            default 50
            depends on ZBOOK_INTERFACE_ACTUATOR_BUZZER

        config ZBOOK_INTERFACE_ACTUATOR_BUZZER_BEEP_DURATION_NORMAL_MS
            int "Normal beep duration (ms)"
            default 150
            depends on ZBOOK_INTERFACE_ACTUATOR_BUZZER

        config ZBOOK_INTERFACE_ACTUATOR_BUZZER_BEEP_DURATION_LONG_MS
            int "Long beep duration (ms)"
            default 400
            depends on ZBOOK_INTERFACE_ACTUATOR_BUZZER
    endmenu
endmenu

if ZBOOK_INTERFACE_ACTUATOR_BUZZER
    module = ZBOOK_INTERFACE_ACTUATOR_BUZZER
    module-str = "zbook buzzer"
    source "subsys/logging/Kconfig.template.log_config"
endif

if ZBOOK_INTERFACE_ACTUATORS_LED
    module = LED
    module-str = led
    source "subsys/logging/Kconfig.template.log_config"
endif
```

## interface/Kconfig.protocols
```kconfig
menu "ZBook Interface - Protocols"

config ZBOOK_INTERFACE_PROTOCOLS
    bool "Enable ZBook Interface Protocols"
    default n
    help
      Enable the ZBook Interface Protocols module.

config ZBOOK_INTERFACE_PROTOCOLS_UART
    bool "Enable ZBook Interface Protocols - UART"
    default y
    depends on ZBOOK_INTERFACE_PROTOCOLS
    help
      Enable the ZBook Interface Protocols - UART module.

if ZBOOK_INTERFACE_PROTOCOLS_UART

module = ZBOOK_INTERFACE_PROTOCOLS_UART
module-str = zbook uart
source "subsys/logging/Kconfig.template.log_config"

endif # ZBOOK_INTERFACE_PROTOCOLS_UART

endmenu
```

## interface/Kconfig.sensors
```kconfig
menu "ZBook Interface - Sensors"

config ZBOOK_INTERFACE_SENSORS
    bool "Enable ZBook Interface Sensors"
    default n
    help
      Enable the ZBook Interface Sensors module.

    menu "ZBook LDR Sensor"
        depends on ZBOOK_INTERFACE_SENSORS

        config ZBOOK_INTERFACE_SENSORS_LDR
            bool "Enable ZBook LDR sensor"
            default y
            select ADC
            depends on ZBOOK_INTERFACE_SENSORS
            help
                Enable zbook_ldr_init/read, a pure-C passthrough over the Zephyr ADC
                driver bound to the ldr_adc devicetree node.
    endmenu
endmenu

if ZBOOK_INTERFACE_SENSORS_LDR
    module = LDR
    module-str = ldr
    source "subsys/logging/Kconfig.template.log_config"
endif
```

## interface/tests/unit/actuators/led_rgb/testcase.yaml
```yaml
tests:
  interface.actuators.led_rgb:
    platform_allow: native_sim
    tags:
      - interface
      - actuators
      - led_rgb
```

## interface/tests/unit/actuators/pwm/testcase.yaml
```yaml
tests:
  interface.actuators.pwm:
    tags:
      - interface
      - actuators
      - pwm
    platform_allow:
      - native_sim
```

## interface/tests/unit/protocols/i2c/testcase.yaml
```yaml
tests:
  interface.protocols.i2c:
    tags:
      - interface
      - protocols
      - i2c
    platform_allow:
      - native_sim
```

## interface/tests/unit/protocols/spi/testcase.yaml
```yaml
tests:
  interface.protocols.spi:
    tags:
      - interface
      - protocols
      - spi
    platform_allow:
      - native_sim
```

## interface/tests/unit/protocols/uart/dts/bindings/serial/vnd,zbook-uart-emul.yaml
```yaml
description: |
  Tags a zephyr,uart-emul stand-in with the TX/RX GPIO pair it represents,
  so zbook_uart_init() can look it up by pin instead of a fixed devicetree
  instance -- exists purely for native_sim unit tests, which have no PIO to
  bit-bang real GPIOs with.

compatible: "vnd,zbook-uart-emul"

include: "zephyr,uart-emul.yaml"

properties:
  zbook,tx-pin:
    type: int
    required: true
    description: GPIO number this channel stands in for as TX.
  zbook,rx-pin:
    type: int
    required: true
    description: GPIO number this channel stands in for as RX.
```

## interface/tests/unit/sensors/microphone/testcase.yaml
```yaml
tests:
  interface.sensors.microphone:
    platform_allow: native_sim
    tags:
      - interface
      - sensors
      - microphone

  interface.sensors.microphone.setup_failure:
    platform_allow: native_sim
    tags:
      - interface
      - sensors
      - microphone
    extra_dtc_overlay_files:
      - app.overlay
      - setup_failure.overlay
    extra_args:
      - EXTRA_CFLAGS=-DMICROPHONE_TEST_SETUP_FAILURE

  interface.sensors.microphone.read_failure:
    platform_allow: native_sim
    tags:
      - interface
      - sensors
      - microphone
    extra_dtc_overlay_files:
      - app.overlay
      - read_failure.overlay
    extra_args:
      - EXTRA_CFLAGS=-DMICROPHONE_TEST_READ_FAILURE
```

## samples/zbook_potentiometer/sample.yaml
```yaml
sample:
  name: ZBook potentiometer sensor
  description: >
    Bring-up sample exposing the zbook potentiometer sensor interface, logging
    the level as a percentage once a second, for manually validating the
    potentiometer on real P2 hardware over the console.
tests:
  sample.sensors.zbook_potentiometer:
    tags:
      - samples
      - interface
      - sensors
      - potentiometer
    platform_allow:
      - zbook@p2/rp2350b/m33
    build_only: true
```

## tests/unit/actuators/buzzer/testcase.yaml
```yaml
tests:
  interface.actuators.buzzer:
    tags:
      - interface
      - actuators
      - buzzer
    platform_allow:
      - native_sim
```

## tests/unit/actuators/display/testcase.yaml
```yaml
common:
  tags:
    - interface
    - actuator
    - display
  platform_allow:
    - native_sim
  integration_platforms:
    - native_sim
tests:
  interface.actuator.display: {}
  interface.actuator.display.no_status_bar:
    extra_args:
      - ZBOOK_TEST_STATUS_BAR=OFF
```

## tests/unit/actuators/led/testcase.yaml
```yaml
tests:
  interface.actuators.led:
    platform_allow: native_sim
    tags:
      - interface
      - actuators
      - led
```

## tests/unit/io/btn/testcase.yaml
```yaml
tests:
  interface.io.btn:
    platform_allow: native_sim
    tags:
      - interface
      - io
      - btn
```

## tests/unit/io/gpio/testcase.yaml
```yaml
tests:
  interface.io.gpio:
    platform_allow: native_sim
    tags:
      - interface
      - io
      - gpio
```

## tests/unit/io/ir/testcase.yaml
```yaml
# SPDX-License-Identifier: Apache-2.0
#
# Copyright (c) Centro de Inovacao EDGE 2026

common:
  platform_allow: native_sim
  tags:
    - interface
    - io
    - ir
tests:
  interface.io.ir:
    extra_args: []
  interface.io.ir.active_low:
    extra_args:
      - EXTRA_DTC_OVERLAY_FILE=active_low.overlay
  interface.io.ir.no_settle:
    extra_configs:
      - CONFIG_ZBOOK_INTERFACE_IO_IR_SETTLE_MS=0
```

## tests/unit/protocols/uart/testcase.yaml
```yaml
tests:
  interface.protocols.uart:
    tags:
      - interface
      - protocols
      - uart
    platform_allow:
      - native_sim
    harness: ztest
    extra_configs:
      - CONFIG_COVERAGE=y
      - CONFIG_COVERAGE_DUMP=y
```

## tests/unit/sensors/ldr/testcase.yaml
```yaml
tests:
  interface.sensors.ldr:
    platform_allow: native_sim
    tags:
      - interface
      - sensors
      - ldr

  interface.sensors.ldr.setup_failure:
    platform_allow: native_sim
    tags:
      - interface
      - sensors
      - ldr
    extra_dtc_overlay_files:
      - app.overlay
      - setup_failure.overlay
    extra_args:
      - EXTRA_CFLAGS=-DLDR_TEST_SETUP_FAILURE

  interface.sensors.ldr.read_failure:
    platform_allow: native_sim
    tags:
      - interface
      - sensors
      - ldr
    extra_dtc_overlay_files:
      - app.overlay
      - read_failure.overlay
    extra_args:
      - EXTRA_CFLAGS=-DLDR_TEST_READ_FAILURE
```

## tests/unit/sensors/potentiometer/testcase.yaml
```yaml
tests:
  interface.sensors.potentiometer:
    platform_allow: native_sim
    tags:
      - interface
      - sensors
      - potentiometer

  interface.sensors.potentiometer.setup_failure:
    platform_allow: native_sim
    tags:
      - interface
      - sensors
      - potentiometer
    extra_dtc_overlay_files:
      - app.overlay
      - setup_failure.overlay
    extra_args:
      - EXTRA_CFLAGS=-DPOTENTIOMETER_TEST_SETUP_FAILURE

  interface.sensors.potentiometer.read_failure:
    platform_allow: native_sim
    tags:
      - interface
      - sensors
      - potentiometer
    extra_dtc_overlay_files:
      - app.overlay
      - read_failure.overlay
    extra_args:
      - EXTRA_CFLAGS=-DPOTENTIOMETER_TEST_READ_FAILURE
```
