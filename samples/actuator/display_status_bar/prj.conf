## CMakeLists.txt
```
# SPDX-License-Identifier: Apache-2.0
#
# Copyright (c) Centro de Inovacao EDGE - 2026

cmake_minimum_required(VERSION 3.20.0)

find_package(Zephyr REQUIRED HINTS $ENV{ZEPHYR_BASE})

project(zbook_display_status_bar_sample)

target_sources(app PRIVATE src/main.c)
```

## sample.yaml
```
sample:
  name: ZBook Display status bar sample
  description: Cycles the status bar icons (Wi-Fi levels, Bluetooth, MicroSD, error) and a menu with cursor and checkboxes.
common:
  tags:
    - interface
    - actuator
    - display
  platform_allow:
    - zbook@p2/rp2350b/m33
  integration_platforms:
    - zbook@p2/rp2350b/m33
tests:
  sample.interface.actuator.display_status_bar:
    build_only: true
```

## prj.conf
```kconfig
CONFIG_ZBOOK_INTERFACE_ACTUATORS=y
CONFIG_ZBOOK_INTERFACE_ACTUATORS_DISPLAY=y
CONFIG_ZBOOK_INTERFACE_ACTUATORS_DISPLAY_ASSETS=y
CONFIG_ZBOOK_INTERFACE_ACTUATOR_DISPLAY_STATUS_BAR=y
CONFIG_OLED_DISPLAY_I2C=y
```

## app.overlay
```dts
/*
 * Copyright (c) Centro de Inovacao EDGE - 2026
 *
 * The SSD1306 takes 400 kHz, which cuts a full frame from ~100 ms to ~25 ms, so the
 * screen no longer visibly paints from top to bottom on every step.
 */

#include <zephyr/dt-bindings/i2c/i2c.h>

/* The deps/display driver only picks its I2C transport from the display_i2c label. */
display_i2c: &oled {};

&i2c0 {
	clock-frequency = <I2C_BITRATE_FAST>;
};
```

## src/main.c
```c
/************************************************************************
 * @file main.c
 *
 * @brief ZBook Display status bar sample: shows the ZBook logo, then cycles the status bar
 * icons and a menu mirroring them.
 * @author João Matheus Nascimento Dias (joao.dias@edge.ufal.br)
 * @version 0.1
 * @date 27/10/2026
 *
 * @copyright Centro de Inovação EDGE 2026. Todos os direitos reservados.
 *
 ***********************************************************************/

#include "actuator/zbook_display.h"
#include "actuator/assets/assets.h"

#include <zephyr/kernel.h>
#include <zephyr/sys/util.h>


#define STEP_TIME_MS 1500
#define MENU_TOP (ZBOOK_DISPLAY_STATUS_BAR_H + 3)
#define MENU_ROW_H 11

struct step {
	enum zbook_display_icon_state states[ZBOOK_DISPLAY_ICON_AMOUNT]; /**< Icon states. */
	uint8_t wifi_level;                                              /**< Wi-Fi level. */
	uint8_t cursor;                                                  /**< Selected row. */
};


#define H ZBOOK_DISPLAY_ICON_HIDDEN
#define F ZBOOK_DISPLAY_ICON_OFF
#define N ZBOOK_DISPLAY_ICON_ON

static const struct step steps[] = {
	{{H, H, H, H}, 3, 0}, {{N, H, H, H}, 0, 0}, {{N, H, H, H}, 1, 0}, {{N, H, H, H}, 2, 0},
	{{N, H, H, H}, 3, 0}, {{N, N, H, H}, 3, 1}, {{N, N, F, H}, 3, 2}, {{N, N, N, H}, 3, 2},
	{{N, N, N, N}, 3, 3}, {{F, N, N, H}, 3, 0}, {{F, F, F, H}, 3, 1},
};

static const char *const labels[ZBOOK_DISPLAY_ICON_AMOUNT] = {
	[ZBOOK_DISPLAY_ICON_WIFI] = "Wi-Fi",
	[ZBOOK_DISPLAY_ICON_BLUETOOTH] = "Bluetooth",
	[ZBOOK_DISPLAY_ICON_SD] = "MicroSD",
	[ZBOOK_DISPLAY_ICON_ERROR] = "Error",
};

static void draw_step(const struct step *s)
{
	zbook_display_clear();
	zbook_display_set_wifi_level(s->wifi_level);

	for (uint8_t i = 0; i < ZBOOK_DISPLAY_ICON_AMOUNT; i++) {
		const uint8_t top = MENU_TOP + (i * MENU_ROW_H);

		zbook_display_set_icon(i, s->states[i]);

		if (i == s->cursor) {
			zbook_display_draw_bitmap(zbook_cursor, top, 0, ZBOOK_CURSOR_W,
						  ZBOOK_CURSOR_H, 1);
		}
		zbook_display_draw_bitmap((s->states[i] == ZBOOK_DISPLAY_ICON_ON)
						  ? zbook_checkbox_on
						  : zbook_checkbox_off,
					  top, 10, ZBOOK_CHECKBOX_ON_W, ZBOOK_CHECKBOX_ON_H, 1);
		zbook_display_print((const uint8_t *)labels[i], top, 22, FONT_SIZE_7, 1);
	}

	zbook_display_flush();
}

int main(void)
{
	zbook_display_init();

	while (true) {
		for (size_t i = 0; i < ARRAY_SIZE(steps); i++) {
			draw_step(&steps[i]);
			k_msleep(STEP_TIME_MS);
		}
	}

	return 0;
}
```
