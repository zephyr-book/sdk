## Kconfig
```
mainmenu "ZBook UART one-direction sample"

config ZBOOK_UART_SAMPLE_ONE_DIRECTION_IS_TX
    bool "ZBook UART sample: one-direction"
    default y
    help
      This sample demonstrates the use of the ZBook UART protocol in a one-direction
      communication scenario. It configures the UART interface for transmission only,
      allowing data to be sent from the device to a connected receiver. The sample
      showcases the initialization, configuration, and data transmission capabilities
      of the ZBook UART protocol, providing a practical example for developers to
      understand and implement one-directional UART communication in their applications.

source "Kconfig.zephyr"
```

## prj.conf
```kconfig
CONFIG_ZBOOK_INTERFACE_PROTOCOLS=y
CONFIG_ZBOOK_INTERFACE_PROTOCOLS_UART=y

CONFIG_LOG=y

CONFIG_ZBOOK_INTERFACE_PROTOCOLS_UART_LOG_LEVEL_DBG=y
CONFIG_ZBOOK_UART_SAMPLE_ONE_DIRECTION_IS_TX=n
```

## app.overlay
```dts
/*
 * zbook_uart picks a PIO block per pin window (GPIO_BASE 0 for pins 0-31,
 * 16 for pins 32-47). The board only enables pio1 (ws2812), so enable the
 * remaining blocks for the UART channels.
 */

&pio0 {
	status = "okay";
};

&pio2 {
	status = "okay";
};
```

## src/main.c
```c
/*******************************************************************
 * @file main.c
 *
 * @brief
 * @author João Matheus Nascimento Dias (joao.dias@edge.ufal.br)
 * @version 0.6
 * @date 25/09/2026
 *
 * @copyright Copyright (c) 2026
 *
 *******************************************************************/

#include "protocols/zbook_uart.h"

#include <zephyr/kernel.h>
#include <zephyr/logging/log.h>

#define GPIO_AMOUNT 4

LOG_MODULE_REGISTER(zbook_uart_sample, LOG_LEVEL_INF);

struct rx_ctx {
	const char *name;
	char buf[64];
	size_t len;
};

static struct rx_ctx rx_ctx[GPIO_AMOUNT] = {
	{.name = "GPIO1"}, {.name = "GPIO39"}, {.name = "GPIO45"}, {.name = "GPIO46"},
};

/* Called per received byte from ISR: accumulate, log once per message. */
static void on_rx_byte(struct zbook_uart_channel *handle, uint8_t byte, void *user_data)
{
	struct rx_ctx *ctx = user_data;

	ARG_UNUSED(handle);

	if (byte == '\0' || ctx->len == sizeof(ctx->buf) - 1) {
		ctx->buf[ctx->len] = '\0';
		LOG_INF("rx on %s: \"%s\"", ctx->name, ctx->buf);
		ctx->len = 0;
		if (byte == '\0') {
			return;
		}
	}

	ctx->buf[ctx->len++] = (char)byte;
}

static struct {
	int gpios[GPIO_AMOUNT];
	char *data[GPIO_AMOUNT];
	struct zbook_uart_channel *uart[GPIO_AMOUNT];
} self = {
	.gpios = {ZBOOK_UART_GPIO_01, ZBOOK_UART_GPIO_39, ZBOOK_UART_GPIO_45, ZBOOK_UART_GPIO_46},
	.data = {"GPIO1", "GPIO39", "GPIO45", "GPIO46"},
};

int main(void)
{
	LOG_INF("Starting zbook UART sample...");

	static const uint8_t tx_data_gpio1[] = "Hello from zbook UART (GPIO1)!";
	static const uint8_t tx_data_gpio39[] = "Hello from zbook UART (GPIO39)!";
	static const uint8_t tx_data_gpio45[] = "Hello from zbook UART (GPIO45)!";
	static const uint8_t tx_data_gpio46[] = "Hello from zbook UART (GPIO46)!";

	for (int i = 0; i < 4; i++) {

#if CONFIG_ZBOOK_UART_SAMPLE_ONE_DIRECTION_IS_TX
		if (zbook_uart_init(self.gpios[i], ZBOOK_UART_PIN_NONE, 115200, &self.uart[i]) !=
		    0) {
			LOG_ERR("failed to open zbook uart on GPIO %d", self.gpios[i]);
			return 0;
		}
#else
		if (zbook_uart_init(ZBOOK_UART_PIN_NONE, self.gpios[i], 115200, &self.uart[i]) !=
		    0) {
			LOG_ERR("failed to open zbook uart on GPIO %d", self.gpios[i]);
			return 0;
		}

		if (zbook_uart_set_rx_callback(self.uart[i], on_rx_byte, &rx_ctx[i]) != 0) {
			LOG_WRN("rx callback not supported on this target, falling back to "
				"polling");
		}
#endif
	}

#if CONFIG_ZBOOK_UART_SAMPLE_ONE_DIRECTION_IS_TX

	while (1) {
		zbook_uart_write(self.uart[0], tx_data_gpio1, sizeof(tx_data_gpio1));
		k_sleep(K_SECONDS(1));
		zbook_uart_write(self.uart[1], tx_data_gpio39, sizeof(tx_data_gpio39));
		k_sleep(K_SECONDS(1));
		zbook_uart_write(self.uart[2], tx_data_gpio45, sizeof(tx_data_gpio45));
		k_sleep(K_SECONDS(1));
		zbook_uart_write(self.uart[3], tx_data_gpio46, sizeof(tx_data_gpio46));
		k_sleep(K_SECONDS(1));
	}

#endif

	return 0;
}
```
