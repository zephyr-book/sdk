## CMakeLists.txt
```
# SPDX-License-Identifier: Apache-2.0
#
# Copyright (c) Centro de Inovacao EDGE - 2026

cmake_minimum_required(VERSION 3.20.0)

find_package(Zephyr REQUIRED HINTS $ENV{ZEPHYR_BASE})

project(zbook_led_sample)

target_sources(app PRIVATE src/main.c src/zbook_led_shell.c)
```

## sample.yaml
```
sample:
  name: ZBook LED shell
  description: >
    Bring-up sample exposing the zbook LED actuator (on/off/blink) as shell
    commands, for manually validating the onboard LEDs on real P2 hardware
    over the console.
tests:
  sample.actuators.led:
    tags:
      - samples
      - interface
      - actuators
      - led
    platform_allow:
      - zbook@p2/rp2350b/m33
    build_only: true
```

## prj.conf
```kconfig
CONFIG_SHELL=y

CONFIG_ZBOOK_INTERFACE_ACTUATORS=y
```

## src/main.c
```c
/************************************************************************
 * @file main.c
 *
 * @brief Entry point for the Zbook LED actuator sample: initializes the
 *        LEDs and exposes the `led` shell commands to drive them manually.
 * @author João Matheus Nascimento Dias (joao.dias@edge.ufal.br)
 *
 * @copyright Centro de Inovação EDGE 2026. Todos os direitos reservados.
 *
 ***********************************************************************/

#include <zephyr/kernel.h>
#include <zephyr/logging/log.h>
#include <stdio.h>

#include "actuators/zbook_led.h"

LOG_MODULE_REGISTER(main);

int main(void)
{
	LOG_INF("Zbook LED Actuator Sample\n");

	int ret = zbook_led_init();

	if (ret < 0) {
		LOG_ERR("zbook_led_init failed (%d)", ret);
	}

	return ret;
}
```

## src/zbook_led_shell.c
```c
/************************************************************************
 * @file zbook_led_shell.c
 *
 * @brief Shell commands for the Zbook LED actuator, to drive it manually
 *        from a serial terminal.
 * @author João Matheus Nascimento Dias (joao.dias@edge.ufal.br)
 *
 * @copyright Centro de Inovação EDGE 2026. Todos os direitos reservados.
 *
 ***********************************************************************/

#include <stdint.h>
#include <stdlib.h>
#include <string.h>
#include <zephyr/shell/shell.h>

#include "actuators/zbook_led.h"

static int parse_led(const struct shell *sh, const char *arg, enum zbook_led *led)
{
	if (strcmp(arg, "all") == 0) {
		*led = ZBOOK_LED_ALL;
		return 0;
	}

	char *end;
	long n = strtol(arg, &end, 10);

	if (*end != '\0' || n < 1 || n > 4) {
		shell_error(sh, "led invalido: %s (use 1-4 ou all)", arg);
		return -EINVAL;
	}

	*led = (enum zbook_led)(n - 1);
	return 0;
}

static int parse_blink_state(const struct shell *sh, const char *arg, enum zbook_led_state *state)
{
	if (strcmp(arg, "default") == 0) {
		*state = ZBOOK_LED_BLINK_DEFAULT;
	} else if (strcmp(arg, "slow") == 0) {
		*state = ZBOOK_LED_BLINK_SLOW;
	} else if (strcmp(arg, "fast") == 0) {
		*state = ZBOOK_LED_BLINK_FAST;
	} else {
		shell_error(sh, "state invalido: %s (use default, slow ou fast)", arg);
		return -EINVAL;
	}

	return 0;
}

/* Bit 0 = LED 1 ... bit 3 = LED 4, i.e. BIT(ZBOOK_LED_n). Accepts decimal or 0x hex. */
static int parse_mask(const struct shell *sh, const char *arg, uint32_t *mask)
{
	char *end;
	unsigned long m = strtoul(arg, &end, 0);

	if (*end != '\0' || m == 0 || m > 0xF) {
		shell_error(sh, "mask invalido: %s (use 0x1-0xF, bit0 = LED 1)", arg);
		return -EINVAL;
	}

	*mask = (uint32_t)m;
	return 0;
}

static int cmd_led_on(const struct shell *sh, size_t argc, char **argv)
{
	enum zbook_led led;
	int ret;

	ret = parse_led(sh, argv[1], &led);
	if (ret < 0) {
		return ret;
	}

	ret = zbook_led_on(led);
	if (ret < 0) {
		shell_error(sh, "zbook_led_on falhou (%d)", ret);
		return ret;
	}

	return 0;
}

static int cmd_led_off(const struct shell *sh, size_t argc, char **argv)
{
	enum zbook_led led;
	int ret;

	ret = parse_led(sh, argv[1], &led);
	if (ret < 0) {
		return ret;
	}

	ret = zbook_led_off(led);
	if (ret < 0) {
		shell_error(sh, "zbook_led_off falhou (%d)", ret);
		return ret;
	}

	return 0;
}

static int cmd_led_blink(const struct shell *sh, size_t argc, char **argv)
{
	enum zbook_led led;
	enum zbook_led_state state;
	int ret;

	ret = parse_led(sh, argv[1], &led);
	if (ret < 0) {
		return ret;
	}

	ret = parse_blink_state(sh, argv[2], &state);
	if (ret < 0) {
		return ret;
	}

	ret = zbook_led_blink(led, state);
	if (ret < 0) {
		shell_error(sh, "zbook_led_blink falhou (%d)", ret);
		return ret;
	}

	return 0;
}

static int cmd_led_mask_on(const struct shell *sh, size_t argc, char **argv)
{
	uint32_t mask;
	int ret;

	ret = parse_mask(sh, argv[1], &mask);
	if (ret < 0) {
		return ret;
	}

	ret = zbook_led_on_mask(mask);
	if (ret < 0) {
		shell_error(sh, "zbook_led_on_mask falhou (%d)", ret);
		return ret;
	}

	return 0;
}

static int cmd_led_mask_off(const struct shell *sh, size_t argc, char **argv)
{
	uint32_t mask;
	int ret;

	ret = parse_mask(sh, argv[1], &mask);
	if (ret < 0) {
		return ret;
	}

	ret = zbook_led_off_mask(mask);
	if (ret < 0) {
		shell_error(sh, "zbook_led_off_mask falhou (%d)", ret);
		return ret;
	}

	return 0;
}

static int cmd_led_mask_toggle(const struct shell *sh, size_t argc, char **argv)
{
	uint32_t mask;
	int ret;

	ret = parse_mask(sh, argv[1], &mask);
	if (ret < 0) {
		return ret;
	}

	ret = zbook_led_toggle_mask(mask);
	if (ret < 0) {
		shell_error(sh, "zbook_led_toggle_mask falhou (%d)", ret);
		return ret;
	}

	return 0;
}

static int cmd_led_mask_blink(const struct shell *sh, size_t argc, char **argv)
{
	uint32_t mask;
	enum zbook_led_state state;
	int ret;

	ret = parse_mask(sh, argv[1], &mask);
	if (ret < 0) {
		return ret;
	}

	ret = parse_blink_state(sh, argv[2], &state);
	if (ret < 0) {
		return ret;
	}

	ret = zbook_led_blink_mask(mask, state);
	if (ret < 0) {
		shell_error(sh, "zbook_led_blink_mask falhou (%d)", ret);
		return ret;
	}

	return 0;
}

SHELL_STATIC_SUBCMD_SET_CREATE(
	sub_led_mask, SHELL_CMD_ARG(on, NULL, "led mask on <mask>", cmd_led_mask_on, 2, 0),
	SHELL_CMD_ARG(off, NULL, "led mask off <mask>", cmd_led_mask_off, 2, 0),
	SHELL_CMD_ARG(toggle, NULL, "led mask toggle <mask>", cmd_led_mask_toggle, 2, 0),
	SHELL_CMD_ARG(blink, NULL, "led mask blink <mask> <default|slow|fast>", cmd_led_mask_blink,
		      3, 0),
	SHELL_SUBCMD_SET_END);

SHELL_STATIC_SUBCMD_SET_CREATE(
	sub_led, SHELL_CMD_ARG(on, NULL, "led on <1-4|all>", cmd_led_on, 2, 0),
	SHELL_CMD_ARG(off, NULL, "led off <1-4|all>", cmd_led_off, 2, 0),
	SHELL_CMD_ARG(blink, NULL, "led blink <1-4|all> <default|slow|fast>", cmd_led_blink, 3, 0),
	SHELL_CMD(mask, &sub_led_mask, "Act on several LEDs at once; mask bit0 = LED 1 (e.g. 0x5)",
		  NULL),
	SHELL_SUBCMD_SET_END);

SHELL_CMD_REGISTER(led, &sub_led, "Zbook LED actuator commands", NULL);
```
