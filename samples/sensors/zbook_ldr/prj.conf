## CMakeLists.txt
```
# SPDX-License-Identifier: Apache-2.0
#
# Copyright (c) Centro de Inovacao EDGE 2026

cmake_minimum_required(VERSION 3.20.0)

find_package(Zephyr REQUIRED HINTS $ENV{ZEPHYR_BASE})
project(zbook_ldr_sample)

target_sources(app PRIVATE src/main.c)
```

## sample.yaml
```
sample:
  name: ZBook LDR sensor
  description: >
    Bring-up sample exposing the zbook LDR sensor interface, logging the
    light level as a percentage once a second, for manually validating the
    LDR on real P2 hardware over the console.
tests:
  sample.sensors.zbook_ldr:
    tags:
      - samples
      - interface
      - sensors
      - ldr
    platform_allow:
      - zbook@p2/rp2350b/m33
    build_only: true
```

## prj.conf
```kconfig
CONFIG_LOG=y
CONFIG_ZBOOK_INTERFACE_SENSORS=y
```

## src/main.c
```c
/************************************************************************
 * @file main.c
 *
 * @brief Periodically reads the ZBook LDR sensor and logs its
 * light level as a percentage.
 * @author João Matheus Nascimento Dias (joao.dias@edge.ufal.br)
 * @date 17/09/2026
 *
 * @copyright Centro de Inovação EDGE 2026. Todos os direitos reservados.
 *
 ***********************************************************************/

#include <zephyr/kernel.h>
#include <zephyr/logging/log.h>

#include "sensors/zbook_ldr.h"

LOG_MODULE_REGISTER(zbook_ldr_sample);

int main(void)
{
	int ret;
	uint16_t level;

	ret = zbook_ldr_init();
	if (ret) {
		LOG_ERR("zbook_ldr_init failed (%d)", ret);
		return ret;
	}

	while (1) {
		ret = zbook_ldr_read(&level);
		if (ret) {
			LOG_ERR("zbook_ldr_read failed (%d)", ret);
		} else {
			LOG_INF("Light level: %u%%", level);
		}

		k_sleep(K_SECONDS(1));
	}

	return 0;
}
```
