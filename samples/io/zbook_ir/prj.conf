## CMakeLists.txt
```
# SPDX-License-Identifier: Apache-2.0
#
# Copyright (c) Centro de Inovacao EDGE 2026

cmake_minimum_required(VERSION 3.20.0)

find_package(Zephyr REQUIRED HINTS $ENV{ZEPHYR_BASE})

project(zbook_ir_sample)

target_sources(app PRIVATE src/main.c)
```

## Kconfig
```
# SPDX-License-Identifier: Apache-2.0
#
# Copyright (c) Centro de Inovacao EDGE 2026

mainmenu "ZBook IR sample"

config SAMPLE_IR_PULSE_PERIOD_MS
	int "Interval between IR emitter pulses in milliseconds"
	default 1000
	range 2 3600000
	help
	  How often the sample fires a pulse on the IR emitter.

config SAMPLE_IR_PULSE_MS
	int "IR emitter pulse duration in milliseconds"
	default 200
	range 1 ZBOOK_INTERFACE_IO_IR_PULSE_MAX_MS
	help
	  How long each IR emitter pulse lasts. Must be shorter than
	  SAMPLE_IR_PULSE_PERIOD_MS and not above
	  ZBOOK_INTERFACE_IO_IR_PULSE_MAX_MS.

source "Kconfig.zephyr"
```

## sample.yaml
```
# SPDX-License-Identifier: Apache-2.0
#
# Copyright (c) Centro de Inovacao EDGE 2026

sample:
  name: ZBook IR I/O
  description: >
    Reflective IR test for the zbook IR I/O interface: periodically pulses
    the onboard IR emitter and logs every DETECTED/LOST event of the IR
    receiver, so holding a surface over the emitter/receiver pair shows
    whether the reflected pulses are being seen.
tests:
  sample.io.zbook_ir:
    tags:
      - samples
      - interface
      - io
      - ir
    platform_allow:
      - zbook@p2/rp2350b/m33
    build_only: true
```

## prj.conf
```kconfig
# SPDX-License-Identifier: Apache-2.0
#
# Copyright (c) Centro de Inovacao EDGE 2026

CONFIG_LOG=y
CONFIG_ZBOOK_INTERFACE_IO=y
```

## src/main.c
```c
/************************************************************************
 * @file main.c
 *
 * @brief Entry point for the Zbook IR I/O sample: periodically pulses the
 *        IR emitter and logs every DETECTED/LOST event of the IR receiver,
 *        as a reflective test of the emitter/receiver pair.
 * @author Matheus Macário dos Santos (matheus.macario@edge.ufal.br)
 * @version 0.1
 * @date 10/11/2026
 *
 * @copyright Centro de Inovação EDGE 2026. Todos os direitos reservados.
 *
 ***********************************************************************/

#include <zephyr/kernel.h>
#include <zephyr/logging/log.h>

#include "io/zbook_ir.h"

LOG_MODULE_REGISTER(main);

BUILD_ASSERT(CONFIG_SAMPLE_IR_PULSE_MS < CONFIG_SAMPLE_IR_PULSE_PERIOD_MS,
	     "The IR pulse must be shorter than the pulse period");

static const char *evt_name(enum zbook_ir_evt evt)
{
	switch (evt) {
	case ZBOOK_IR_EVT_DETECTED:
		return "detected";
	case ZBOOK_IR_EVT_LOST:
		return "lost";
	default:
		return "unknown";
	}
}

static void on_ir_evt(enum zbook_ir_evt evt, void *user_data)
{
	const char *label = user_data;

	LOG_INF("[%s] IR %s", label, evt_name(evt));
}

int main(void)
{
	int ret;

	LOG_INF("Zbook IR I/O Sample");
	LOG_INF("Hold a surface over the IR emitter/receiver pair to see the pulses");

	ret = zbook_ir_init();
	if (ret < 0) {
		LOG_ERR("zbook_ir_init failed (%d)", ret);
		return ret;
	}

	ret = zbook_ir_reg_cb(ZBOOK_IR_EVT_BOTH, on_ir_evt, "sample");
	if (ret < 0) {
		LOG_ERR("zbook_ir_reg_cb failed (%d)", ret);
		return ret;
	}

	while (1) {
		ret = zbook_ir_emitter_pulse(CONFIG_SAMPLE_IR_PULSE_MS);
		if (ret < 0) {
			LOG_ERR("zbook_ir_emitter_pulse failed (%d)", ret);
			return ret;
		}

		k_msleep(CONFIG_SAMPLE_IR_PULSE_PERIOD_MS);
	}

	return 0;
}
```
