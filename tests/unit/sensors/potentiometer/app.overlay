#include <zephyr/dt-bindings/adc/adc.h>

adc: &adc0 {
	ref-internal-mv = <3300>;
	#address-cells = <1>;
	#size-cells = <0>;

	potentiometer: channel@0 {
		reg = <0>;
		zephyr,gain = "ADC_GAIN_1";
		zephyr,reference = "ADC_REF_INTERNAL";
		zephyr,acquisition-time = <ADC_ACQ_TIME_DEFAULT>;
	};
};
